## bench/esp_noise_crypto/main/Kconfig.projbuild
```kconfig
# SPDX-License-Identifier: Apache-2.0
# SPDX-FileCopyrightText: Copyright 2026 avatarsd LLC

menu "Noise crypto bench (#2065)"
    choice NOISE_BENCH_BACKEND
        prompt "Crypto backend"
        default NOISE_BENCH_BACKEND_PSA
        help
            The backend the NNpsk0 handshake and the per-frame AEAD run on. NONE builds the
            same app with every crypto call compiled out: the baseline image the backend's
            flash and static RAM are measured against.

        config NOISE_BENCH_BACKEND_NONE
            bool "none (baseline image)"
        config NOISE_BENCH_BACKEND_PSA
            bool "mbedTLS PSA Crypto (ships with ESP-IDF)"
    endchoice
endmenu
```

## integrations/esp-idf/examples/concepts/arena_sizing/main/Kconfig.projbuild
```kconfig
# SPDX-License-Identifier: Apache-2.0
# SPDX-FileCopyrightText: Copyright 2026 avatarsd LLC

menu "arena_sizing example"

    config EXAMPLE_SHOW_INIT_EXHAUSTION
        bool "End with an init-time registration the arena cannot hold"
        default n
        help
            After the run-time refusal, call register_vertex once more. It is
            infallible (ADR-0056), so libtracer prints the sizing message naming
            the sub-pool and the bytes it needed, then aborts. On a board that
            abort is a reset, so this is off by default.

endmenu
```
