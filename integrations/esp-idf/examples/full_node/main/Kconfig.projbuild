## integrations/esp-idf/examples/full_node/main/Kconfig.projbuild
```kconfig
menu "full_node example"

    config FULL_NODE_WIFI_SSID
        string "Wi-Fi SSID (empty = loopback-only, no radio)"
        default ""
        help
            SSID of the Wi-Fi station to join. Leave empty (the default, and
            what CI builds) to skip Wi-Fi entirely: the node's self-proof runs
            over lwIP's loopback netif. Set it (plus the password) to make the
            node's UDP listener reachable from a real host peer on the LAN.

    config FULL_NODE_WIFI_PASSWORD
        string "Wi-Fi password"
        default ""
        help
            WPA2 password for FULL_NODE_WIFI_SSID. Ignored when the SSID is
            empty.

endmenu
```

## integrations/esp-idf/examples/inprocess_mirror/sdkconfig.defaults
```kconfig
# SPDX-License-Identifier: Apache-2.0
# SPDX-FileCopyrightText: Copyright 2026 avatarsd LLC
#
# Defaults for the libtracer P0 in-process smoke app.
#
# C++ exceptions and RTTI are intentionally left at the ESP-IDF default (OFF):
# the libtracer reference core is exception-free and RTTI-free in its data path
# (it returns std::expected, never throws; uses no typeid/dynamic_cast), so the
# P0 profile links clean under -fno-exceptions -fno-rtti. Do not enable them on
# the core's account.

# Give app_main a little extra stack — the in-process graph touches std::
# containers (unordered_map / vector) during register/write.
CONFIG_ESP_MAIN_TASK_STACK_SIZE=8192

# CI compile-coverage for the esp_http_server-backed WS link. This example does
# not USE httpd_ws_link_t (it is an in-process/loopback smoke app), but enabling
# WS support makes the component CMakeLists compile httpd_ws_link.cpp here — the
# ONLY CI build that exercises the WS-on path (full_node keeps it off so its
# footprint sentinel is not charged for a TU it does not bind). Without this,
# httpd_ws_link.cpp compiles nowhere in CI and a break in it (or in the
# esp_http_server requirement wiring) is only caught by a downstream firmware
# build. inprocess_mirror has no footprint gate, so the extra TU costs nothing here.
CONFIG_HTTPD_WS_SUPPORT=y
```
